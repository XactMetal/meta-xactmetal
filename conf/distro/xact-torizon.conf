## conf/distro/xact-torizon.conf
```bitbake
require conf/distro/include/xact-torizon.inc
require conf/distro/sota.conf.inc

DISTRO = "xact-torizon"
DISTRO_NAME = "Torizon-Xact"

DISTRO_FLAVOUR_experimental = " (EXPERIMENTAL)"
```
